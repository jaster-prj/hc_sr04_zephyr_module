## Kconfig
```kconfig
# HC-SR04 configuration options

# Copyright (c) 2016 Intel Corporation
# Copyright (c) 2024 Croxel Inc
# SPDX-License-Identifier: Apache-2.0

menu "Module HC-SR04"

rsource "src/Kconfig"

endmenu
```

## dts/bindings/sensor/hc-sr04.yaml
```yaml
# Copyright (c) 2020 Daniel Veilleux
# SPDX-License-Identifier: LicenseRef-BSD-5-Clause-Nordic

description: HC-SR04 Ultrasonic Ranging Module

compatible: "hc-sr04"

include: base.yaml

properties:
  trig-gpios:
    type: phandle-array
    description: Trigger pin
    required: true

  echo-gpios:
    type: phandle-array
    description: Echo pin
    required: true
```

## src/Kconfig
```kconfig
# HC-SR04 Ultrasonic Ranging Module
#
# Copyright (c) 2020 Daniel Veilleux
#
# SPDX-License-Identifier: LicenseRef-BSD-5-Clause-Nordic
#

config HC_SR04
	bool "HC-SR04 Ultrasonic Ranging Module"
	default y
	help
	  Enable HC-SR04 ultrasonic distance sensor.

if HC_SR04

module = HC_SR04
module-str = hc-sr04
source "${ZEPHYR_BASE}/subsys/logging/Kconfig.template.log_config"

endif
```
